## arch/arm64/src/bcm2711/Kconfig
```kconfig
#
# For a description of the syntax of this configuration file,
# see the file kconfig-language.txt in the NuttX tools repository.
#

if ARCH_CHIP_BCM2711

menu "Broadcom BCM2711 Peripheral Selection"

config BCM2711_LOW_PERIPHERAL
    bool "BCM2711 Low Peripheral Mode"
    default y
    ---help---
        Use the Broadcom BCM2711 in low peripheral addressing mode.

endmenu # Broadcom BCM2711 Peripheral Selection

endif # ARCH_CHIP_BCM2711
```

## boards/arm64/bcm2711/raspberrypi-4b/Kconfig
```kconfig
#
# For a description of the syntax of this configuration file,
# see the file kconfig-language.txt in the NuttX tools repository.
#

if ARCH_BOARD_RASPBERRYPI_4B

    # TODO: make this option a multi-select instead of range select
    config RPI4B_RAM
        int "Raspberry Pi 4B RAM size (in GB)"
        default 4
        ---help---
            The size of the Raspberry Pi 4B's RAM in GB. Supports
            1GB, 2GB, 4GB and 8GB models.

    config RPI4B_DEBUG_BOOT
        bool "Raspberry Pi 4B bootloader debug output"
        default n
        ---help---
            Enables the debug output of the Raspberry Pi 4B bootloader.


endif # ARCH_BOARD_RASPBERRYPI_4B
```
